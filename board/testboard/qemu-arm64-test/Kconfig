## board/testboard/qemu-arm64-test/Kconfig
```kconfig
if TARGET_QEMU_ARM64_TEST

config SYS_BOARD
        default "qemu-arm64-test"

config SYS_VENDOR
        default "testboard"

config SYS_SOC
        default "qemu-arm64-test"

config SYS_CONFIG_NAME
        default "qemu-arm64-test"

source "board/testboard/common/Kconfig"
endif
```
